## Documentation/devicetree/bindings/leds/backlight/silergy,sy7758.yaml
```yaml
# SPDX-License-Identifier: (GPL-2.0-only OR BSD-2-Clause)
%YAML 1.2
---
$id: http://devicetree.org/schemas/leds/backlight/silergy,sy7758.yaml#
$schema: http://devicetree.org/meta-schemas/core.yaml#

title: Silergy SY7758 I2C Backlight Driver

maintainers:
  - Kancy Joe <kancy2333@outlook.com>

properties:
  compatible:
    const: silergy,sy7758

  reg:
    maxItems: 1
    description: I2C address of the device on the parent I2C bus

required:
  - compatible
  - reg

additionalProperties: false

examples:
  - |
    #include <dt-bindings/i2c/i2c.h>

    i2c {
        #address-cells = <1>;
        #size-cells = <0>;

        backlight@63 {
            compatible = "silergy,sy7758";
            reg = <0x63>;
            pinctrl-names = "default";
            pinctrl-0 = <&backlight_pins>;
            vdd-supply = <&vdd_backlight>;
            status = "okay";
        };
    };

...
```
